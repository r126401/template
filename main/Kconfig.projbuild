## main/Kconfig.projbuild
```kconfig
menu "Configuracion template"

config TIPO_DISPOSITIVO
	int "Tipo de dispositivo"
	default 0
	help
		indica el tipo de dispositivo


config NUM_TOPICS
	int "Topics de la aplicacion"
	default 3
	help 
		Indica los topics a gestionar por el dispositivo






menu "Device configuration"

config GPIO_PIN_RELE
	int "Pin gipo para activar el rele"
	default 12
	help 
		Indica el pin gpi con el que se activa el rele

config GPIO_PIN_LED
	int "Pin gipo para activar el led"
	default 13
	help 
		Indica el pin gpi con el que se activa el LED

config GPIO_PIN_BOTON
	int "Pin gipo para activar el boton"
	default 10
	help 
		Indica el pin gpi con el que se activa el boton


endmenu


menu "Task Configuration"

config RESOURCE_EVENT_TASK
	int "memory event task"
	default 4096
	help 
		Indica la memoria de la tarea event_task

config RESOURCE_MQTT_TASK
	int "memory mqtt task"
	default 8192
	help 
		Indica la memoria de la tarea mqtt_task

config RESOURCE_SMARTCONFIG_TASK
	int "memory smartconfig task"
	default 4096
	help 
		Indica la memoria de la tarea smartconfig_task


config RESOURCE_OTA_TASK
	int "memory ota task"
	default 4096
	help 
		Indica la memoria de la tarea ota_task

config RESOURCE_APP_TASK
	int "memory app task"
	default 4096
	help 
		Indica la memoria de la tarea app_task
endmenu

endmenu
```
